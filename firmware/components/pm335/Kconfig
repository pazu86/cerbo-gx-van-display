## firmware/components/pm335/Kconfig
```kconfig
menu "Projecta PM335 (Bluetooth, optional)"

    config PM335_ENABLE
        bool "Connect to a Projecta Intelli-RV PM335 over Bluetooth"
        default n
        help
            Adds water tanks and Hot water / Water pump switches to the Overview and a
            PM335 card to the web page. Off: the Overview shows large temperature tiles
            (the original layout) and Bluetooth is never started.

    config PM335_MAC
        string "PM335 BLE address"
        default "00:00:00:00:00:00"
        help
            The unit's Bluetooth address (the IntelliJay app lists it; or scan with
            nRF Connect). The login password (the app's pairing key) is not set here:
            it's stored on the display through the web API.

    config PM335_POLL_S
        int "System status poll interval (s)"
        default 3
        range 2 300

endmenu
```

## firmware/main/Kconfig.projbuild
```kconfig
menu "Van Display"

    config DISPLAY_TITLE
        string "Title shown in the header and on the web page"
        default "My Van"

    config DISPLAY_HOSTNAME
        string "Network hostname (http://<hostname>.local)"
        default "van-display"

    config DISPLAY_TZ
        string "Time zone (POSIX TZ string)"
        default "AEST-10"
        help
            Local time for the clock, schedules and trip dates. Note POSIX
            signs are inverted: "AEST-10" is UTC+10. Examples: Brisbane
            "AEST-10", Sydney/Melbourne "AEST-10AEDT,M10.1.0,M4.1.0/3",
            Perth "AWST-8", Auckland "NZST-12NZDT,M9.5.0,M4.1.0/3",
            London "GMT0BST,M3.5.0/1,M10.5.0", US Pacific "PST8PDT,M3.2.0,M11.1.0".

endmenu
```
